; PolarFire SoC FPGA Programming
; Exercises: PARAMETERS, MKTEMP, UNZIP, JTAG.PROGRAM.JAM, RM

PARAMETERS &design_file &action

LOCAL &tmpdir &job_file &result

IF "&design_file"==""
(
  DIALOG.OK "Please specify a design file"
  ENDDO
)

; Create temp directory and extract design
MKTEMP &tmpdir
UNZIP "&design_file" "&tmpdir"

; Program FPGA via JTAG
&job_file="&tmpdir/design.jam"
IF OS.FILE("&job_file")
(
  JTAG.PROGRAM.JAM "&job_file" /Action=PROGRAM /Define=DO_VERIFY=1
)
ELSE
(
  PRINT %ERROR "JAM file not found in archive"
  RM "&tmpdir"
  ENDDO
)

; Verify
JTAG.PROGRAM.JAM "&job_file" /Action=VERIFY
&result=PRACTICE.CALLER.FILE(1)
PRINT "Programmed from: &result"

; Cleanup
RM "&tmpdir"

ENDDO
