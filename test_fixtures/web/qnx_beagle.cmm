; QNX on BeagleBone Black Debug Setup
; Exercises: SCREEN.ALways, TERM.METHOD COM, MMU.SCAN,
;            TRANSlation.*, TASK.CONFIG, MENU.ReProgram,
;            sYmbol.AutoLOAD.CHECKLINUX, GROUP.Create /RED,
;            HELP.FILTER.Add

LOCAL &qnx_ifs &procnto

SCREEN.ALways

SYStem.RESet
SYStem.CPU AM3358-GP
SYStem.Option DACR ON
SYStem.JtagClock 20MHz
SYStem.Up

; Terminal setup
TERM.METHOD COM COM1 115200. 8 NONE 1STOP

; Configure MMU and translation
MMU.FORMAT LINUX swapper_pg_dir 0xC0000000--0xCFFFFFFF 0x80000000
MMU.SCAN
TRANSlation.Create 0xC0000000--0xCFFFFFFF 0x80000000
TRANSlation.COMMON 0xBF000000--0xFFFFFFFF
TRANSlation.ON

; Load QNX IFS
&qnx_ifs="ifs-am335x.raw"
Data.LOAD.Binary "&qnx_ifs" 0x80100000

; RTOS awareness
TASK.CONFIG ~~/demo/arm/kernel/qnx/qnx.t32
MENU.ReProgram ~~/demo/arm/kernel/qnx/qnx.men

; Symbol auto-loading
sYmbol.AutoLOAD.CHECKLINUX "do ~~/demo/arm/kernel/qnx/autoload_qnx.cmm"

; Group for threads
GROUP.Create "MyThreads" thread_1 thread_2 thread_3 /RED

; Help filter
HELP.FILTER.Add "qnx"

Go
WAIT 5s

ENDDO
