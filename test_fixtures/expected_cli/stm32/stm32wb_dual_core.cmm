; @target: STM32WB55
; @arch: Cortex-M4 + Cortex-M0+
; @purpose: Dual-core debug session
; @requires: SWD, Power Debug II USB
; @cli-mode: batch

; STM32WB55 Dual-Core Debug Session

SCREEN.OFF
AREA.Create CLI_OUTPUT
AREA.Select CLI_OUTPUT
ON ERROR GOSUB error_handler

LOCAL &elf_cpu1 &elf_cpu2
LOCAL &pc_m4 &sp_m4 &pc_m0 &sp_m0
LOCAL &ipcc_c1cr &ipcc_c2cr

ENTRY &elf_cpu1 &elf_cpu2
IF "&elf_cpu1"==""
  &elf_cpu1="stm32wb_app_m4.elf"
IF "&elf_cpu2"==""
  &elf_cpu2="stm32wb_copro_m0.elf"

SYStem.RESet
SYStem.CPU STM32WB55
SYStem.CONFIG.DEBUGPORTTYPE SWD
SYStem.JtagClock 10MHz

; Dual-core configuration
SYStem.CONFIG.CORE 1. 2.

SYStem.Up

; Load Cortex-M4 application (CPU1)
Data.LOAD.Elf "&elf_cpu1" /CORE 0.

; Load Cortex-M0+ coprocessor firmware (CPU2)
Data.LOAD.Elf "&elf_cpu2" /CORE 1.

; Print register views per core
PRINT "[CORE0] arch=Cortex-M4 role=application"
WinPrint.Register.view /CORE 0.
PRINT "[CORE1] arch=Cortex-M0+ role=coprocessor"
WinPrint.Register.view /CORE 1.

; Print code views per core
WinPrint.Data.List /CORE 0.
WinPrint.Data.List /CORE 1.

; Print local variables for M4
WinPrint.Frame.view /CORE 0. /Locals /Caller

; Set breakpoints on both cores
Break.Set main /CORE 0.
Break.Set IPCC_C1_RX_IRQHandler /CORE 0.
Break.Set main /CORE 1.
Break.Set IPCC_C2_RX_IRQHandler /CORE 1.

; Run both cores
Go
WAIT !STATE.RUN() 10s

; Read CPU1 (Cortex-M4) registers
&pc_m4=Register(/CORE 0. PC)
&sp_m4=Register(/CORE 0. SP)
PRINT "[CORE0] pc=" FORMAT.Hex(8., &pc_m4)
PRINT "[CORE0] sp=" FORMAT.Hex(8., &sp_m4)

; Read CPU2 (Cortex-M0+) registers
&pc_m0=Register(/CORE 1. PC)
&sp_m0=Register(/CORE 1. SP)
PRINT "[CORE1] pc=" FORMAT.Hex(8., &pc_m0)
PRINT "[CORE1] sp=" FORMAT.Hex(8., &sp_m0)

; Check IPCC (Inter-Processor Communication Controller) at 0x58000C00
&ipcc_c1cr=Data.Long(D:0x58000C00)
&ipcc_c2cr=Data.Long(D:0x58000C10)
PRINT "[IPCC] c1cr=" FORMAT.Hex(8., &ipcc_c1cr)
PRINT "[IPCC] c2cr=" FORMAT.Hex(8., &ipcc_c2cr)

; Check shared SRAM2 communication buffer at 0x20030000
PRINT "[SRAM2] shared_buf=" FORMAT.Hex(8., Data.Long(D:0x20030000))

IF !STATE.RUN()
(
  PRINT "[STATUS] cores_halted=TRUE"
  WinPrint.Frame.view /CORE 0. /Locals
  WinPrint.Frame.view /CORE 1. /Locals
)
ELSE
(
  PRINT "[STATUS] cores_halted=FALSE"
)

PRINT "[STATUS] operation=SUCCESS"

ENDDO TRUE()

error_handler:
  PRINT "[ERROR] line=" PRACTICE.CALLER.LINE()
  ENDDO FALSE()
