; STM32H743 Flash Programming and Verify
; Cortex-M7 via SWD, Power Debug II at /opt/t32/

LOCAL &elf_path &confirm &flash_result
LOCAL &verify_ok

ENTRY &elf_path
IF "&elf_path"==""
  &elf_path="stm32h7_app.elf"

SYStem.RESet
SYStem.CPU STM32H743
SYStem.CONFIG.DEBUGPORTTYPE SWD
SYStem.Up

TOOLBAR ON

; Confirm before flash erase
DIALOG.YESNO "Erase STM32H7 internal flash before programming?"
ENTRY &confirm
IF "&confirm"!="TRUE"
(
  PRINT "Flash programming cancelled by user"
  ENDDO
)

; Progress window
WinPOS 0. 0. 80. 5. 0. 0. W_PROGRESS
PRINT "Erasing flash..."

; Flash configuration - STM32H743 internal flash
; Bank 1: 0x08000000--0x080FFFFF (1MB, 128KB sectors)
; Bank 2: 0x08100000--0x081FFFFF (1MB, 128KB sectors)
FLASH.RESet
FLASH.Create 1. 0x08000000--0x080FFFFF 0x20000 TARGET Long
FLASH.Create 2. 0x08100000--0x081FFFFF 0x20000 TARGET Long

; Program
PRINT "Programming flash..."
FLASH.Program ALL /Erase
Data.LOAD.Elf "&elf_path"
FLASH.Program off

; Show loaded code
WinPOS 0. 6. 80. 20. 0. 0. W_CODE
Data.List

; Verify
Data.LOAD.Elf "&elf_path" /ComPare
IF FOUND()
(
  PRINT %ERROR "Flash verification FAILED - mismatch detected"
  &verify_ok=FALSE()
)
ELSE
(
  PRINT "Flash verification PASSED"
  &verify_ok=TRUE()
)

; Reset and run from flash
SYStem.Down
SYStem.Up
Go
WAIT !STATE.RUN() 5s

PRINT "STM32H7 flash programming complete"

ENDDO
