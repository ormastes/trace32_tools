; STM32H743 Peripheral Register Inspection
; Cortex-M7 via SWD, Power Debug II at /opt/t32/

LOCAL &gpio_moder &gpio_odr &gpio_idr
LOCAL &usart_cr1 &usart_brr &usart_isr
LOCAL &spi_cr1 &spi_sr &spi_dr

SYStem.RESet
SYStem.CPU STM32H743
SYStem.CONFIG.DEBUGPORTTYPE SWD
SYStem.Up

TOOLBAR ON
STATUSBAR ON

; Load symbols for peripheral names
Data.LOAD.Elf "stm32h7_app.elf" /NoCODE

; GPIO peripheral window - GPIOA base 0x58020000
WinPOS 0. 0. 60. 12. 0. 0. W_GPIO
PER.view "GPIOA" 0x58020000

; UART peripheral window - USART1 base 0x40011000
WinPOS 62. 0. 60. 12. 0. 0. W_UART
PER.view "USART1" 0x40011000

; SPI peripheral window - SPI1 base 0x40013000
WinPOS 0. 13. 60. 12. 0. 0. W_SPI
PER.view "SPI1" 0x40013000

; Read GPIO registers
&gpio_moder=Data.Long(D:0x58020000)     ; GPIOA_MODER
&gpio_odr=Data.Long(D:0x58020014)       ; GPIOA_ODR
&gpio_idr=Data.Long(D:0x58020010)       ; GPIOA_IDR
PRINT "GPIOA MODER: " FORMAT.Hex(8., &gpio_moder)
PRINT "GPIOA ODR:   " FORMAT.Hex(8., &gpio_odr)
PRINT "GPIOA IDR:   " FORMAT.Hex(8., &gpio_idr)

; Configure GPIOA pin 5 as output (LED on Nucleo board)
; MODER bits [11:10] = 01 for output
&gpio_moder=(&gpio_moder&~(0x3<<10.))|(0x1<<10.)
Data.Set D:0x58020000 %Long &gpio_moder

; Toggle LED
Data.Set D:0x58020014 %Long (&gpio_odr|0x20)   ; Set pin 5
PRINT "LED ON"
WAIT 1s
Data.Set D:0x58020014 %Long (&gpio_odr&~0x20)  ; Clear pin 5
PRINT "LED OFF"

; Read USART1 registers
&usart_cr1=Data.Long(D:0x40011000)      ; USART1_CR1
&usart_brr=Data.Long(D:0x4001100C)      ; USART1_BRR
&usart_isr=Data.Long(D:0x4001101C)      ; USART1_ISR
PRINT "USART1 CR1: " FORMAT.Hex(8., &usart_cr1)
PRINT "USART1 BRR: " FORMAT.Hex(8., &usart_brr)
PRINT "USART1 ISR: " FORMAT.Hex(8., &usart_isr)

; Read SPI1 registers
&spi_cr1=Data.Long(D:0x40013000)        ; SPI1_CR1
&spi_sr=Data.Long(D:0x40013008)         ; SPI1_SR
PRINT "SPI1 CR1: " FORMAT.Hex(8., &spi_cr1)
PRINT "SPI1 SR:  " FORMAT.Hex(8., &spi_sr)

; Check USART transmit ready
IF (&usart_isr&0x80)!=0
  PRINT "USART1 TXE: ready"
ELSE
  PRINT "USART1 TXE: not ready"

; Check SPI busy flag
IF (&spi_sr&0x80)!=0
  PRINT %WARNING "SPI1 BSY: busy"
ELSE
  PRINT "SPI1 BSY: idle"

PRINT "STM32H7 peripheral inspection complete"

ENDDO
