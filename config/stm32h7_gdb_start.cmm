; Repo-managed STM32H7 TRACE32 startup for GDB bridge runs.
DO /opt/t32/stm32h7_startup.cmm
SYStem.Option SemiHost ON
SETUP.API.GDB.Enable /PORT 2331
Break
ENDDO
